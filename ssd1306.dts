/dts-v1/;
/plugin/;

/ {
    compatible = "brcm,bcm2708";

    fragment@0 {
        target = <&i2c1>;
        __overlay__ {
            status = "okay";

            #address-cells = <1>;
			#size-cells = <0>;
            
            ssd1306: oled@3c {
                compatible = "solomon,ssd1306fb-i2c";
                reg = <0x3c>;
                reset-gpios = <&gpio 4 0>;
                solomon,width = <128>;
                solomon,height = <64>;
		solomon,com-invdir = <1>;
		solomon,prechargep1 = <0x1>;
		solomon,prechargep2 = <0xf>;
		solomon,page-offset = <0>;
            };
        };
    };
};

